## boards/shields/niklat/Kconfig.defconfig
```kconfig
if SHIELD_NIKLAT_LEFT

config ZMK_KEYBOARD_NAME
	default "NikLat KBD"

config ZMK_SPLIT_ROLE_CENTRAL
	default y

endif

if SHIELD_NIKLAT_LEFT || SHIELD_NIKLAT_RIGHT

config ZMK_SPLIT
	default y

endif
```

## boards/shields/niklat/Kconfig.shield
```kconfig
config SHIELD_NIKLAT_LEFT
	def_bool $(shields_list_contains,niklat_left)
config SHIELD_NIKLAT_RIGHT
	def_bool $(shields_list_contains,niklat_right)
```
